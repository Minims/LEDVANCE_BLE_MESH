## sdkconfig.defaults
```kconfig
CONFIG_PARTITION_TABLE_CUSTOM=y
CONFIG_PARTITION_TABLE_CUSTOM_FILENAME="partitions.csv"
CONFIG_PARTITION_TABLE_FILENAME="partitions.csv"
CONFIG_PARTITION_TABLE_OFFSET=0x8000
CONFIG_PARTITION_TABLE_MD5=y

CONFIG_ESPTOOLPY_FLASHSIZE_4MB=y
CONFIG_ESPTOOLPY_FLASHSIZE="4MB"

CONFIG_BROKER_URL="mqtt://192.168.1.214:1883"
CONFIG_USERNAME_MQTT=""
CONFIG_PASSWORD_MQTT=""
CONFIG_BLE_MESH_ESP32C6_DEV=y
CONFIG_ESP_WIFI_SSID=""
CONFIG_ESP_WIFI_PASSWORD=""
CONFIG_ESP_MAXIMUM_RETRY=5
# CONFIG_ESP_WIFI_AUTH_OPEN is not set
# CONFIG_ESP_WIFI_AUTH_WEP is not set
# CONFIG_ESP_WIFI_AUTH_WPA_PSK is not set
CONFIG_ESP_WIFI_AUTH_WPA2_PSK=y

# --- Bluetooth & BLE Mesh Configuration ---
CONFIG_BT_ENABLED=y
CONFIG_BT_BLUEDROID_ENABLED=y
CONFIG_BT_CONTROLLER_ENABLED=y
CONFIG_BLE_MESH=y
CONFIG_BLE_MESH_NODE=y
CONFIG_BLE_MESH_PROV=y
CONFIG_BLE_MESH_PB_GATT=y
CONFIG_BLE_MESH_PB_ADV=y
CONFIG_BLE_MESH_GENERIC_ONOFF_CLI=y
CONFIG_BLE_MESH_GENERIC_LEVEL_CLI=y
CONFIG_BLE_MESH_LIGHT_LIGHTNESS_CLI=y

# --- Critical: Force BLE 4.2 for Mesh Compatibility (Fixes BTM_BleScan error) ---
CONFIG_BT_BLE_42_FEATURES_SUPPORTED=y
CONFIG_BT_BLE_50_FEATURES_SUPPORTED=n
CONFIG_BT_BLE_42_SCAN_EN=y

# MQTT
CONFIG_MQTT_PROTOCOL_311=y
CONFIG_MQTT_TRANSPORT_SSL=y
CONFIG_MQTT_TRANSPORT_WEBSOCKET=y
CONFIG_MQTT_TRANSPORT_WEBSOCKET_SECURE=y
```
